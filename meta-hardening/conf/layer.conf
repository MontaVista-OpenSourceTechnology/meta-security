## meta-hardening/conf/layer.conf
```bitbake
# We have a conf and classes directory, add to BBPATH
BBPATH .= ":${LAYERDIR}"

# We have a recipes directory, add to BBFILES
BBFILES += "${LAYERDIR}/recipes*/*/*.bb ${LAYERDIR}/recipes*/*/*.bbappend"

BBFILE_COLLECTIONS += "harden-layer"
BBFILE_PATTERN_harden-layer = "^${LAYERDIR}/"
BBFILE_PRIORITY_harden-layer = "10"

LAYERSERIES_COMPAT_harden-layer = "dunfell"

LAYERDEPENDS_harden-layer = "core openembedded-layer"

#INHERIT += "distrooverrides"
#DISTRO_FEATURES_OVERRIDES += "harden"
DISTROOVERRIDES_append = "${@bb.utils.contains('DISTRO_FEATURES', 'harden', ':harden', '', d)}"
```
